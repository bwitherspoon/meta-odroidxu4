## conf/layer.conf
```bitbake
# We have a conf and classes directory, add to BBPATH
BBPATH .= ":${LAYERDIR}"

# We have recipes-* directories, add to BBFILES
BBFILES += "${LAYERDIR}/recipes-*/*/*.bb \
	${LAYERDIR}/recipes-*/*/*.bbappend"

BBFILE_COLLECTIONS += "odroidxu4"
BBFILE_PATTERN_odroidxu4 = "^${LAYERDIR}/"
BBFILE_PRIORITY_odroidxu4 = "6"
```

## conf/machine/odroidxu4.conf
```bitbake
include conf/machine/include/tune-cortexa15.inc

DEFAULTTUNE = "armv7vethf"

SERIAL_CONSOLE = "115200 ttySAC2"

MACHINE_FEATURES = "ext2 vfat usbhost"

PREFERRED_PROVIDER_virtual/kernel = "linux-odroidxu3"

KERNEL_DEVICETREE = "exynos5422-odroidxu3.dtb"

EXTRA_IMAGEDEPENDS += "u-boot"

UBOOT_MACHINE = "odroid-xu3_defconfig"
```
